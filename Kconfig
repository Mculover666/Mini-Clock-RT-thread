## Kconfig
```kconfig
mainmenu "RT-Thread Configuration"

config BSP_DIR
    string
    option env="BSP_ROOT"
    default "."

config RTT_DIR
    string
    option env="RTT_ROOT"
    default "rt-thread"

config PKGS_DIR
    string
    option env="PKGS_ROOT"
    default "packages"

source "$RTT_DIR/Kconfig"
source "$PKGS_DIR/Kconfig"
source "$PKGS_DIR/packages/misc/samples/Kconfig"

config SOC_FAMILY_STM32
    bool

config SOC_SERIES_STM32L4
    bool
    select ARCH_ARM_CORTEX_M4
    select SOC_FAMILY_STM32

config SOC_STM32L431RCTX
    bool
    select SOC_SERIES_STM32L4
    select RT_USING_COMPONENTS_INIT
    select RT_USING_USER_MAIN
    default y
```
